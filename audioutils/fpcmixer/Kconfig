## games/quake/Kconfig
```kconfig
#
# For a description of the syntax of this configuration file,
# see the file kconfig-language.txt in the NuttX tools repository.
#

config GAMES_QUAKE
	tristate "Quake"
	default n
	depends on ALLOW_GPL_COMPONENTS && (MODULES || ARCH_SIM)
	depends on m || ARCH_SIM
	---help---
		id Software's Quake (WinQuake's software renderer, by way of
		quakegeneric), full screen on the FPC's GPU: 320 x 200 shown
		at 4:3 in the desktop's mode (960 x 720 in 1280 x 720 and
		1280 x 800), the GPU's game keyboard.  Needs the game's data,
		id1/pak0.pak (the shareware's will do), in
		GAMES_QUAKE_BASEDIR.  A loadable module only (/mnt/sd0/bin):
		it takes no memory while it is not running (in the simulator
		it may be built in).  -res W: the software renderer at
		W x 3W/4, scaled the most whole times that fit (-res 480:
		2 x 2, the same size on the screen as 320 x 200, at about
		10 fps against 23 in the timedemo; -res 640: 1 x 1, 5 fps).
		-gl: the view drawn by the 3D GPU (fpcgl: docs/gpu3d.md).

if GAMES_QUAKE

config GAMES_QUAKE_PRIORITY
	int "Priority"
	default 100

config GAMES_QUAKE_STACKSIZE
	int "Stack size"
	default 16384
	---help---
		The renderer's big arrays (edges, surfaces, spans) are not on
		the stack here, as they were in WinQuake: what is left is the
		BSP's recursion and the usual.

config GAMES_QUAKE_BASEDIR
	string "Data directory"
	default "/mnt/sd0/quake"
	---help---
		Where id1/ is (-basedir on the command line overrides it).

config GAMES_QUAKE_HUNKSIZE
	int "Hunk (KB)"
	default 5440
	---help---
		Quake's own memory for a level, its models and sounds (-mem N
		in megabytes overrides it).  5440 KB is the least the game
		accepts for the shareware episode (MINIMUM_MEMORY).

config GAMES_QUAKE_HEAPSIZE
	int "Heap besides the hunk (KB)"
	default 960
	---help---
		The rest of what the game allocates: the surface cache (about
		600 KB at 320 x 200), the depth buffer (125 KB), and whatever
		of GAMES_QUAKE_SRAM's arrays the SRAM has no room for: one block
		of the user heap (the hunk another), which goes back whole when
		the game ends.  -res makes it larger by what the frame, the
		depth buffer and the surface cache take besides, the hunk
		smaller by up to 725 KB if the PSRAM has no room for both
		(what DOS Quake's minimum gave its video buffers).

config GAMES_QUAKE_SRAM
	bool "The renderer's hottest arrays in the internal SRAM"
	default y
	---help---
		The edge and surface lists and the span lists (about 180 KB)
		and the frame buffer from the kernel heap (the SRAM) while the
		game runs, if there is room, rather than from its heap in the
		PSRAM behind the 16 KB XIP cache.

endif
```

## graphics/fpcdesk/Kconfig
```kconfig
#
# For a description of the syntax of this configuration file,
# see the file kconfig-language.txt in the NuttX tools repository.
#

menuconfig GRAPHICS_FPCDESK
	bool "FPC desktop (a composited desktop shell for NX)"
	default n
	depends on NX && NX_RAMBACKED
	select NX_COMPOSITOR if NX_ACCEL
	select PSEUDOTERM
	---help---
		A modern desktop for the FPC: a top bar with the clock, a dock,
		windows with title bars, traffic-light buttons, round corners
		and soft shadows, all drawn and composited by the GPU through
		the NX server (CONFIG_NX_COMPOSITOR).  The terminal runs NSH
		on pseudo-terminals, in tabs.  A dark and a light theme.  The
		System Log reads the RAM log (CONFIG_RAMLOG_SYSLOG).

if GRAPHICS_FPCDESK

config FPCDESK_PROGNAME
	string "Program name"
	default "desk"

config FPCDESK_PRIORITY
	int "Priority"
	default 100

config FPCDESK_STACKSIZE
	int "Stack size"
	default 8192

config FPCDESK_TERM_STACKSIZE
	int "Terminal (NSH) stack size"
	default 8192

config FPCDESK_TERM_PRIORITY
	int "Terminal (NSH) priority"
	default 100

config FPCDESK_TERM_SCROLLBACK
	int "Terminal scrollback (lines a tab)"
	default 500
	---help---
		The most lines a terminal tab keeps after they scroll off the
		top.  They are allocated as they come, trimmed of trailing
		blanks.

config FPCDESK_LISTENER_STACKSIZE
	int "NX event listener stack size"
	default 4096

config FPCDESK_SYSMON_DISK
	string "System Monitor: disk mount point"
	default ""
	---help---
		A mount point whose use the System Monitor shows (statfs()),
		e.g. /mnt/sd0.  Empty for none.  A disk that is not mounted is
		shown as such.

config FPCDESK_SYSMON_DISKNAME
	string "System Monitor: disk name"
	default "Disk"
	---help---
		The name the System Monitor gives the disk, e.g. microSD.

config FPCDESK_WALLPAPER
	bool "Wallpaper"
	default n
	---help---
		A wallpaper drawn by the GPU (gradients and soft glows, three
		to choose from in Settings).  It is a surface the size of the
		display: a quarter of the GPU's memory at 1280 x 800.  Without
		it the background is black.

config FPCDESK_WIDGETS
	bool "Widgets: the widget kit's gallery"
	default y
	---help---
		An application that shows every control of the widget kit
		(desk_kit.h, docs/uikit.md) in each of its states, with lists,
		dialogs, menus and tooltips: the kit's demonstration and test.

config FPCDESK_PREFS
	string "Settings file"
	default ""
	---help---
		Where the desktop keeps the settings it remembers across boots
		(the display mode, the wallpaper, the theme, the dock, ...).
		Empty: .fpcdesk in the home directory ($HOME, else
		CONFIG_LIBC_HOMEDIR).

if GAMES_NXDOOM_DESKTOP

config FPCDESK_DOOM_PRIORITY
	int "Doom: priority"
	default 90
	---help---
		The game's task, below the desktop's so that the desktop stays
		quick to answer while it runs.

config FPCDESK_DOOM_STACKSIZE
	int "Doom: stack size"
	default 8192

config FPCDESK_DOOM_WADDIRS
	string "Doom: where else to look for the game's data"
	default ""
	---help---
		Directories, separated by spaces, where Doom's window looks for
		an IWAD (doom1.wad, doom.wad, doom2.wad, freedoom1.wad, ...)
		after the home directory ($HOME, else CONFIG_LIBC_HOMEDIR).
		Doom keeps its configuration and saved games in .doom/ beside
		the IWAD it found.

config FPCDESK_GAME_CPUSCALE
	bool "Games: scale frames on the CPU"
	default n
	---help---
		A game's frames are scaled to its window across by the CPU (for
		free: a palette lookup gives the pixel twice) and down by the
		GPU (each row PUT once into a hidden window, then COPYed as many
		times as the scale).  This scales down on the CPU too and PUTs
		all of it: twice the bytes on the link at 2x.  For comparison.

endif

config FPCDESK_SOUND
	bool "Sound: system sounds, the volume control, Settings' Sound page"
	default y
	depends on FPC_AUDIO
	---help---
		With the FPC's audio mixer (/dev/mixer): a speaker in the top
		bar with a popover (the volume, mute, what is playing, each
		program's level), a Sound page in Settings (the volume, mute,
		the alert volume, interface sounds, the applications' levels),
		and short system sounds (a window opening, closing, an alert, a
		notification).  The volume keys show the popover.

config FPCDESK_MUSIC
	bool "Music player"
	default y
	depends on FPCDESK_SOUND
	---help---
		A Music application: plays the WAV files (and MP3 files with
		AUDIOUTILS_LIBMAD) of a folder, one after the other.

config FPCDESK_MUSIC_DIR
	string "Music: the folder"
	default ""
	depends on FPCDESK_MUSIC
	---help---
		Where the Music application looks for files.  Empty: the home
		directory ($HOME, else CONFIG_LIBC_HOMEDIR), and its Music
		folder if it has one.

config FPCDESK_BENCH
	bool "GPU Bench: benchmarks, meters and demonstrations of the GPU"
	default y
	depends on FPC_GPU && NX_COMPOSITOR
	---help---
		An application that measures the FPC's GPU (FILL, COPY, the
		kinds of BLEND, EXPAND, BC1), its link (PUT, READ), the
		compositor and the commands a second, by the GPU's own clock
		where it has one (v6 STATS); graphs of how busy the GPU and
		its SDRAM are and of the link, from /proc/gpu; and
		demonstrations of what it draws.  It calls the board's GPU
		driver (a flat build).

config FPCDESK_CHESS
	bool "Chess"
	default y
	---help---
		Chess against the computer (six levels) or two players at one
		board, with its own engine in a thread of its own; and the
		chess command: the engine's move generator checked against the
		standard positions (chess perft), its speed (chess bench), its
		move in a position (chess go).

if FPCDESK_CHESS

config FPCDESK_CHESS_TT_KB
	int "Chess: the engine's transposition table (KB)"
	default 512
	---help---
		The positions the engine remembers while it searches, 12
		bytes each, from the heap (the PSRAM on the board) while the
		Chess window is open.  Halved until it fits if memory is short.

config FPCDESK_CHESS_PRIORITY
	int "Chess: the engine's priority"
	default 90
	---help---
		The engine's thread, below the desktop's so that the desktop
		stays quick to answer while it thinks.

config FPCDESK_CHESS_STACKSIZE
	int "Chess: the engine's stack, besides its search"
	default 12288
	---help---
		The engine's thread keeps its search (about 14 KB) on its
		stack, so that on the board it is in the SRAM; this is the
		stack it has besides, for its recursion.

endif

config FPCDESK_DESKCTL
	bool "deskctl: scripted input and screenshots"
	default y
	---help---
		deskctl m X Y [BUTTONS]  move the pointer (and press buttons)
		deskctl c X Y [N]        click (N times)
		deskctl k TEXT           type
		deskctl shot FILE        screenshot (simulator)
		deskctl freeze [SECONDS] stop the clock, the blinking, the games
		deskctl dock APP [r]     click an application's dock icon
		deskctl wins             the windows, top first
		For testing the desktop without a mouse and keyboard.

config FPCDESK_SHEET_CMD
	bool "sheet: the Spreadsheet's engine from NSH"
	default y
	---help---
		sheet --selftest [DIR]  the formula engine's tests
		sheet --bench [ROWS]    a big sheet's memory and recalculation
		sheet FILE              a .csv or .sheet file's values

endif
```

## graphics/fpcgame/Kconfig
```kconfig
#
# For a description of the syntax of this configuration file,
# see the file kconfig-language.txt in the NuttX tools repository.
#

menuconfig GRAPHICS_FPCGAME
	bool "FPC game SDK (full-screen 2D games on the GPU)"
	default n
	depends on FPC_GPU && NX_ACCEL
	---help---
		Full-screen 2D games on the FPC's GPU (protocol v8): a canvas
		shown scaled up (SET_SCALE), images, sprites (plain, flipped,
		scaled, rotated: SPRITE), tile layers, text, a pad from the
		keyboard and TRI's sixteen-voice sound engine (samples and FM)
		into the mixer.  docs/games.md.

if GRAPHICS_FPCGAME

config FPCGAME_TRI
	bool "TRI games' runtime"
	default y
	---help---
		TRI's game API (tri_sdk.h, TRI's own SDK sources) on the FPC:
		its VDP command lists run on the GPU (sprites, tile layers),
		its sound commands on the same engine.  TRI games build as
		they are.

config FPCGAME_DEMO
	tristate "fgdemo: the SDK's demonstration"
	default n

endif
```

## graphics/fpcwasm/Kconfig
```kconfig
#
# For a description of the syntax of this configuration file,
# see the file kconfig-language.txt in the NuttX tools repository.
#

config GRAPHICS_FPCWASM
	tristate "WebAssembly apps (wasm: WAMR and the fpc API)"
	default n
	depends on INTERPRETERS_WAMR && GRAPHICS_FPCGAME
	---help---
		The wasm command: sandboxed WebAssembly apps and games on WAMR
		(interpreted, or compiled ahead of time by wamrc on a PC), with
		WASI and the FPC's own API (sdk/fpc_wasm.h: a full-screen game,
		images, sprites, layers, text, input, sound) on the game SDK.
		docs/wasm.md.

if GRAPHICS_FPCWASM

config FPCWASM_APPDIR
	string "Where apps are installed"
	default "/mnt/sd0/apps"
	---help---
		A directory a app: NAME/app.wasm (and app.aot), manifest,
		icon.bmp, its data.  The desktop's launcher lists them.

config FPCWASM_STACKSIZE
	int "The wasm command's stack"
	default 16384
	---help---
		The task's (native) stack: the interpreter's frames, the game
		SDK's, and AOT code's frames (a wasm call each).

config FPCWASM_ROCKSN
	bool "rocksn: the Rocks example as a native program"
	default n
	---help---
		sdk/examples/rocks/rocks.c built as a native NuttX program on
		sdk/fpc_native.c (the fpc API straight onto the game SDK): the
		same game as the WebAssembly app, to compare their frame times
		(rocksn -b N, wasm run rocks -b N).

endif
```
