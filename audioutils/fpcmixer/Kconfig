## interpreters/micropython/Kconfig
```kconfig
#
# For a description of the syntax of this configuration file,
# see the file kconfig-language.txt in the NuttX tools repository.
#

menuconfig INTERPRETERS_MICROPYTHON
	bool "MicroPython"
	default n
	---help---
		MicroPython (micropython.org), a small Python 3 for
		microcontrollers, as a NuttX program: a REPL with line editing
		and history on the terminal it is started from (the serial
		console, a pseudo-terminal: the desktop's Terminal), scripts
		(python FILE.py) and -c.  The version the Makefile pins is
		downloaded, patched (patches/) and built at build time.  The
		files are those of NuttX (open(), os), and with the FPC desktop
		the fpc module opens windows on it.

if INTERPRETERS_MICROPYTHON

config INTERPRETERS_MICROPYTHON_PROGNAME
	string "Program name"
	default "python"

config INTERPRETERS_MICROPYTHON_PRIORITY
	int "Priority"
	default 90
	---help---
		Below the desktop's (100), so that it stays quick while a
		Python program computes.

config INTERPRETERS_MICROPYTHON_STACKSIZE
	int "Stack size"
	default 16384
	---help---
		The stack of the task that runs the interpreter.  Python code
		does not use it for its objects (they are in the heap below)
		but the compiler and the VM recurse on it: 16 KB takes a few
		dozen nested calls and expressions as deep as people write.
		Stacks are in the SRAM on the FPC board (ARM_STACKS_KERNEL_HEAP),
		which is small: see INTERPRETERS_MICROPYTHON_PSRAM_STACK.

config INTERPRETERS_MICROPYTHON_PSRAM_STACK
	int "Stack from the heap (0: none)"
	default 0
	---help---
		Run the interpreter on a thread whose stack, this many bytes, is
		allocated from the heap (the PSRAM on the FPC board) instead of
		the task's own stack: the task's stack
		(INTERPRETERS_MICROPYTHON_STACKSIZE) can then be small (4 KB).
		The PSRAM is behind the XIP cache, so a stack there is slower.

config INTERPRETERS_MICROPYTHON_HEAPSIZE
	int "Heap size (KB)"
	default 1024
	---help---
		The garbage-collected heap for Python's objects, allocated from
		the heap when the interpreter starts (the PSRAM on the FPC
		board) and freed when it ends.  python -X heapsize=N[K|M]
		changes it for a run.

config INTERPRETERS_MICROPYTHON_PATH
	string "sys.path"
	default "/mnt/sd0/lib"
	---help---
		Where import looks for modules after the script's own folder,
		separated by colons.  ~/ is the home directory.  The
		MICROPYPATH environment variable replaces it.

config INTERPRETERS_MICROPYTHON_DOUBLE
	bool "Floats are double precision"
	default y if ARCH_SIM
	default n
	---help---
		Python's float as a C double (as CPython) rather than a float.
		The Cortex-M33's FPU has single precision only: doubles are done
		in software, larger and slower.

config INTERPRETERS_MICROPYTHON_NATIVE
	bool "Native code emitters (native, viper, asm_thumb)"
	default y
	depends on (ARCH_ARMV7M || ARCH_ARMV8M) && !ARCH_SIM
	---help---
		The @micropython.native and @micropython.viper decorators compile
		a function to Thumb-2 machine code, and @micropython.asm_thumb
		takes inline assembly.  The code goes in the heap (the PSRAM on
		the FPC board, which the Cortex-M33 executes from).  Only for
		ARMv7-M and ARMv8-M-mainline (Thumb-2) processors: not the
		simulator.

config INTERPRETERS_MICROPYTHON_FPC
	bool "The fpc module: windows on the FPC desktop"
	default y
	depends on GRAPHICS_FPCDESK && FPCDESK_CLIENTS
	---help---
		import fpc: open windows on the desktop, draw into them with the
		GPU (rectangles, round ones, gradients, text in the desktop's
		fonts, images), take their events (mouse, keys, resizes, frames)
		and put the widget kit's controls in them (buttons, labels,
		fields, sliders, check boxes, lists, ...).

config INTERPRETERS_MICROPYTHON_AGENT
	bool "The agent: an AI coding agent (agent command)"
	default y
	depends on NETUTILS_NETCOP && SYSTEM_NSH && BUILTIN
	---help---
		agent: an AI agent in the terminal (docs/agent.md), a light
		Claude Code.  It talks to the Anthropic Messages API or an
		OpenAI-compatible Chat Completions API over the network
		coprocessor (TLS on it) and has local tools: files, search,
		NSH commands, web pages.  The C half is the _agent module
		(HTTP and server-sent events, NSH commands with their output,
		grep and glob, the line editor); the agent itself is Python
		(the agent package, frozen into the firmware).

config INTERPRETERS_MICROPYTHON_AGENT_HEAPSIZE
	int "The agent's heap (KB)"
	default 2048
	depends on INTERPRETERS_MICROPYTHON_AGENT
	---help---
		The MicroPython heap the agent runs with: the conversation,
		the files read, the requests and responses.  AGENT_HEAP=N in
		the environment changes it for a run.

endif
```

## netutils/netcop/Kconfig
```kconfig
#
# For a description of the syntax of this configuration file,
# see the file kconfig-language.txt in the NuttX tools repository.
#

config NETUTILS_NETCOP
	bool "netcop: the network coprocessor's daemon (netcopd)"
	default n
	depends on NET_USRSOCK && NET_USRSOCK_DEVICE
	---help---
		netcopd makes ordinary sockets work through the fpc's network
		coprocessor (a XIAO ESP32-C6 or -S3 on SPI0 or a UART,
		fpc/docs/netcop.md):
		WiFi, TLS and SSH done by the coprocessor, its BLE keyboards,
		mice and game pads into /dev/vinput (fpc/drivers/netcop).  The
		library (netutils/netcop.h) gives programs TLS on a socket, SSH
		sessions and the control socket for WiFi, BLE and the rest.

if NETUTILS_NETCOP

config NETCOP_DEVPATH
	string "The coprocessor's UART, or its SPI link"
	default "/dev/netcop" if FPC_NETCOP_SPI
	default "/dev/ttyS0"

config NETCOP_BAUD
	int "Speed asked for once the link is up (0: stay at the first)"
	default 20000000 if FPC_NETCOP_SPI
	default 3000000
	---help---
		UART: the baud rate (the link starts at 115200).  SPI
		(FPC_NETCOP_SPI): the clock in Hz (the link starts at 10 MHz;
		the coprocessor takes up to 40 MHz).  A speed that fails soon
		after the switch is halved at the next try.

config NETCOP_FLOWCONTROL
	bool "RTS/CTS flow control on the UART"
	default y
	depends on !FPC_NETCOP_SPI

config NETCOP_WINDOW
	int "Receive window per socket (bytes, in the heap)"
	default 8192

config NETCOP_NTP_SERVERS
	string "NTP servers (separated by ;)"
	default "pool.ntp.org"
	depends on NETUTILS_NTPCLIENT
	---help---
		NuttX's NTP client is started with these once WiFi is up; the
		port is CONFIG_NETUTILS_NTPCLIENT_PORTNO.

config NETCOP_HOSTNAME
	string "Name given in HELLO"
	default "fpc"

config NETCOP_CLOCK_VALID
	bool "The clock is right at boot"
	default n
	---help---
		The coprocessor gets the time (TIME_SET, its fallback) at link
		up only if the clock is known to be right (a battery-backed
		RTC); otherwise once NTP has set it.

config NETCOP_DEBUG
	bool "Log every usrsock request"
	default n

config NETCOP_PRIORITY
	int "netcopd priority"
	default 110

config NETCOP_STACKSIZE
	int "netcopd stack size"
	default 3072

endif # NETUTILS_NETCOP
```

## testing/mm/psramtest/Kconfig
```kconfig
#
# For a description of the syntax of this configuration file,
# see the file kconfig-language.txt in the NuttX tools repository.
#

config TESTING_PSRAMTEST
	tristate "RP2350 PSRAM test"
	default n
	depends on ARCH_CHIP_RP23XX && RP23XX_PSRAM
	---help---
		A test of all of the RP2350's QSPI PSRAM: the detected part and
		size, data and address lines, address-in-address, random
		patterns, byte/halfword/word and unaligned accesses, bursts
		across pages and dies, retention, speed.  It overwrites the whole
		PSRAM: for firmware with RP23XX_PSRAM_HEAP_NONE (what the
		firmware keeps at the start of the PSRAM is saved and put back).

if TESTING_PSRAMTEST

config TESTING_PSRAMTEST_PROGNAME
	string "Program name"
	default "psramtest"

config TESTING_PSRAMTEST_PRIORITY
	int "Task priority"
	default 100

config TESTING_PSRAMTEST_STACKSIZE
	int "Stack size"
	default 4096

endif
```
