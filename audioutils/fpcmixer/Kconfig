## audioutils/fpcmixer/Kconfig
```kconfig
#
# For a description of the syntax of this configuration file,
# see the file kconfig-language.txt in the NuttX tools repository.
#

config AUDIOUTILS_FPCMIXER
	tristate "mixer: the FPC's audio mixer from the shell"
	default n
	depends on FPC_AUDIO
	---help---
		mixer                        what is playing, the volumes
		mixer master [N|+N|-N]       the master volume, percent
		mixer mute [on|off|toggle]
		mixer level NAME N           an application's level, percent
		mixer tone FREQ MS [RATE [CH [BITS [AMP [NAME [VOL]]]]]]
		                             a sine through a free channel
		mixer wav FILE [NAME]        a WAV file through a free channel
		mixer watch [N]              the state each time it changes
		(nuttx/audio/fpc_mixer.h, fpc/drivers/audio)

if AUDIOUTILS_FPCMIXER

config AUDIOUTILS_FPCMIXER_PRIORITY
	int "Priority"
	default 100

config AUDIOUTILS_FPCMIXER_STACKSIZE
	int "Stack size"
	default 4096

endif
```

## devtools/xcc/Kconfig
```kconfig
#
# For a description of the syntax of this configuration file,
# see the file kconfig-language.txt in the NuttX tools repository.
#

config DEVTOOLS_XCC
	tristate "xcc: a small C compiler (C to WebAssembly, C to Thumb-2)"
	default n
	depends on ALLOW_MIT_COMPONENTS
	depends on m || ARCH_SIM
	---help---
		tyfkda's xcc (https://github.com/tyfkda/xcc, MIT), a small
		C compiler written in C, on the board: wcc compiles C to a
		WebAssembly (WASI) program for the WebAssembly runtime.  Its
		headers and C library (WASI) are DEVTOOLS_XCC_ROOT/include
		and /lib.  A loadable module (/mnt/sd0/bin): no memory taken
		while it is not running (in the simulator it is built in).
		docs/xcc.md.

if DEVTOOLS_XCC

config DEVTOOLS_XCC_NATIVE
	bool "xcc: C to native NuttX modules (Thumb-2)"
	default y
	---help---
		The xcc program: C to loadable modules for this board's
		Cortex-M33 (Thumb-2, hard float), with xcc's ARM32 backend,
		assembler and linker; the NuttX headers the firmware was built
		with (DEVTOOLS_XCC_ROOT/arm).  What a module calls in the
		firmware must be in its symbol table: nuttx/symtab.list adds
		the C library's and the run-time ABI's functions to it.
		Native modules are not sandboxed: a bad pointer can bring the
		system down (docs/xcc.md).

config DEVTOOLS_XCC_ROOT
	string "Headers and libraries"
	default "/mnt/sd0/xcc"
	---help---
		Where include/ and lib/ are ($XCC_ROOT overrides it).

config DEVTOOLS_XCC_PRIORITY
	int "Priority"
	default 100

config DEVTOOLS_XCC_STACKSIZE
	int "Stack size"
	default 32768
	---help---
		The parser and the code generator recurse along the
		expressions and statements of the program compiled.

endif
```

## games/NXDoom/Kconfig
```kconfig
#
# For a description of the syntax of this configuration file,
# see the file kconfig-language.txt in the NuttX tools repository.
#

config GAMES_NXDOOM
	tristate "NXDoom"
	default n
	depends on ALLOW_GPL_COMPONENTS
	depends on VIDEO_FB
	depends on CRYPTO
	depends on LIBC_LOCALE
	---help---
		Play DOOM on NuttX!

if GAMES_NXDOOM

comment "Program options"

config GAMES_NXDOOM_PRIORITY
	int "Priority"
	default 100
	---help---
		The task priority for the NXDoom application.

config GAMES_NXDOOM_STACKSIZE
	int "Stack size"
	default 4096
	---help---
		The stack size for the NXDoom application.

comment "General game options"

choice # Language
	prompt "Game language"
	default GAMES_NXDOOM_LANG_EN

	config GAMES_NXDOOM_LANG_EN
		bool "English"
		---help---
			English language support (original).

	config GAMES_NXDOOM_LANG_FR
		bool "French"
		---help---
			French language support.
endchoice # Language

config GAMES_NXDOOM_PREFDIR
	string "DOOM data directory"
	default "/data"
	---help---
		Directory where DOOM WAD files are stored.

config GAMES_NXDOOM_ENDOOM
	bool "Show ENDOOM"
	default n
	---help---
		Show the ENDOOM screen (https://www.doomwiki.org/wiki/ENDOOM).

comment "Networking options"

config GAMES_NXDOOM_NET
	bool "Enable network features"
	default n
	---help---
		Not ported! Will not work.

if GAMES_NXDOOM_NET

config GAMES_NXDOOM_NET_LOGS
	bool "Enable network logging"
	default n
	---help---
		Enables log information from the network features.

config GAMES_NXDOOM_NET_MAXPLAYERS
	int "Maximum number of players"
	default 6
	---help---
		The maximum number of players, multiplayer/networking.
		This is the maximum supported by the networking code; individual games
		have their own values for MAXPLAYERS that can be smaller.
		ChocolateDOOM default was 8.

config GAMES_NXDOOM_NET_BACKUPTICS
	int "Maximum number of backup tics"
	default 32
	---help---
		The maximum number of backup tics to store locally during a net game.
		ChocalateDOOM default was 128.

config GAMES_NXDOOM_NET_MAXPLAYERNAME
	int "Maximum player name length"
	default 16
	---help---
		The maximum number of characters in a player name for netgames.
		ChocalateDOOM default was 30.

endif # GAMES_NXDOOM_NET

comment "Sound options"

config GAMES_NXDOOM_SOUND
	bool "Enable sound features"
	default n
	---help---
		Sound effects through GAMES_NXDOOM_FPCSOUND; otherwise not
		ported.  No music.

if GAMES_NXDOOM_SOUND

config GAMES_NXDOOM_FPCSOUND
	bool "Sound effects through the FPC's audio mixer"
	default y
	depends on FPC_AUDIO
	---help---
		Doom's sound effects mixed to 11025 Hz stereo into a mixer
		channel named "Doom" (src/i_fpcsound.c).

config GAMES_NXDOOM_RTTTL_MUSIC
	bool "RTTTL music"
	default n
	depends on AUDIOUTILS_RTTTL_C
	depends on !DISABLE_PTHREAD
	---help---
		Play music using RTTTL.

config GAMES_NXDOOM_RTTTL_DEVICE
	string "RTTTL device"
	default "/dev/pwm0"
	depends on GAMES_NXDOOM_RTTTL_MUSIC
	---help---
		Device for RTTTL output (only PWM currently supported).

endif # GAMES_NXDOOM_SOUND

comment "Graphics options"

choice # Output
	prompt "Where the game is shown"
	default GAMES_NXDOOM_FB

	config GAMES_NXDOOM_FB
		bool "Frame buffer"
		---help---
			Draw on GAMES_NXDOOM_FBPATH, read GAMES_NXDOOM_KBDPATH.

	config GAMES_NXDOOM_GAME
		bool "The FPC's games (fpc/game.h)"
		depends on GRAPHICS_GAME
		---help---
			Doom on the FPC's game library: full screen or in a
			window of the desktop (F11 switches), its 320 x 200
			frame shown at 4:3 (game_present8(): one PUT8 a group
			of rows, the GPU looks the pixels up in the palette),
			the keys and the mouse from game_event().  Held while
			its window is not the active one.  With no -iwad, it
			looks for an IWAD in $HOME, /home and /games/doom, and
			keeps its configuration and saves in .doom/ beside it.

endchoice # Output

if GAMES_NXDOOM_FB

config GAMES_NXDOOM_FBPATH
	string "Framebuffer path"
	default "/dev/fb0"
	---help---
		Path to the framebuffer character driver to use for rendering.

comment "Input options"

choice # Input method
	prompt "NXDoom input method"
	default GAMES_NXDOOM_KEYBOARD

	config GAMES_NXDOOM_KEYBOARD
		bool "Keyboard"
		---help---
			Use a NuttX keyboard character driver.

endchoice # Input method

if GAMES_NXDOOM_KEYBOARD

config GAMES_NXDOOM_KBDPATH
	string "Keyboard device path"
	default "/dev/kbd0"
	---help---
		Path to the keyboard device to use as input.

endif # GAMES_NXDOOM_KEYBOARD

endif # GAMES_NXDOOM_FB

config GAMES_NXDOOM_SRAM
	bool "What the renderer touches most in the internal SRAM"
	default y
	depends on GAMES_NXDOOM_GAME && !GAMES_NXDOOM_STATIC_SCRNBUF
	---help---
		From the kernel's heap (the internal SRAM) while the game runs,
		not from the game's heap in the PSRAM, whose 16 KB cache the
		code from the flash shares: the 64000-byte screen buffer (the
		renderer writes it a column at a time, 320 bytes apart, each
		in a different cache line) and the light tables (COLORMAP,
		every pixel drawn goes through them).  Without the room, the
		game's heap as before.

config GAMES_NXDOOM_FASTCODE
	bool "The renderer's inner loops and their variables in the SRAM"
	default y
	depends on ARCH_CHIP_RP23XX
	---help---
		The column and span drawers, the wall loop, the plane mapper,
		the BSP walk and the fixed-point helpers (about 6 KB) in
		.time_critical.nxdoom, and the variables they use all the time
		(the clip and plane arrays, the light tables, the wall loop's
		state: about 29 KB) in .sram_bss.nxdoom: in the SRAM while the
		game runs, if there is room (fpc_place.h): out of the 16 KB XIP
		cache that the code from the flash and the game's data in the
		PSRAM share, where every texture and flat read evicts them.
		The timedemo, 300 MHz: 29.2 frames a second without, 33.9 with
		the code, 41.9 with all of it and GAMES_NXDOOM_DRAWQ.

config GAMES_NXDOOM_DRAWQ
	bool "The columns and spans drawn on the other core"
	default y
	depends on SMP && GAMES_NXDOOM_SRAM
	---help---
		In high detail the renderer only notes what to draw (a ring
		of up to 16 KB in the SRAM), and a thread pinned to the other
		core draws it in order while the game, pinned to the first,
		walks the BSP, clips and sorts.  Nothing changes on the
		screen.  Both cores then read the PSRAM through the one XIP
		cache, and the game's own reads slow down: worth a few per
		cent while the PSRAM is what the frame waits on.

config GAMES_NXDOOM_ZONE
	bool "Doom's own zone allocator"
	default y
	---help---
		The zone as the game was written for (src/z_zone.c): one block
		of the heap, the cache purged inside it as a new allocation
		needs room.  Without it (src/z_native.c) every block is the C
		library's and the cache is freed into the heap when it fills,
		whose bookkeeping then lands in freed blocks at once: the game
		corrupted its heap that way within minutes on the board.

comment "Memory"

config GAMES_NXDOOM_HEAPSIZE
	int "Heap of its own (KB, 0: the system's)"
	default 0
	---help---
		The game caches the WAD until an allocation fails, so on the
		system heap it takes all there is.  A heap of its own, taken
		at start and freed whole at exit, caps it at this size and
		leaves nothing behind.  The shareware and Freedoom episodes
		play in 4 MB.  "-mb N" overrides it (MB).

config GAMES_NXDOOM_RESTART
	bool "Start afresh every time"
	default y
	depends on GAMES_NXDOOM = y
	---help---
		A builtin program's variables keep the values of its last run,
		but DOOM expects its initial ones.  The game's objects are
		linked into one block (ld -r); nxdoom saves its data before the
		first run and restores it, and clears its bss, on every start.
		Costs a copy of the data (about 40 KB).

config GAMES_NXDOOM_STATE_PSRAM
	bool "Keep the game's variables in external RAM"
	default n
	depends on GAMES_NXDOOM_RESTART
	---help---
		Put the game's data and bss (about 220 KB, mostly the
		renderer's tables) in .psram_data.nxdoom and .psram_bss.nxdoom,
		for a board whose linker script places .psram_data* and
		.psram_bss* in external RAM.

config GAMES_NXDOOM_FB_CMAP
	bool "Draw through the frame buffer colour map"
	default n
	---help---
		DOOM draws into an 8-bit palettised buffer and normally converts
		every pixel to the pixel format of the frame buffer as it blits.
		A frame buffer that has a colour map of its own can do that
		conversion in hardware while it scans the display out, so enable
		this to load the DOOM palette into the colour map and blit the
		palette indices unconverted.

		This needs a frame buffer that is 8 bits per pixel and supports
		FBIOPUT_CMAP, such as an STM32 LTDC layer configured for L8.  It
		both removes the conversion and halves the amount of data written
		per frame, which matters most when the frame buffer is external
		memory.

config GAMES_NXDOOM_FILLSCREEN
	bool "Stretch the image to the whole display"
	default n
	---help---
		By default the 320x200 image is scaled by the largest whole number
		that fits, which leaves a border on a display whose size is not an
		exact multiple of it.  Enable this to stretch the image over the
		entire frame buffer instead, which fills the display at the cost of
		a scale factor that is not uniform across the image.

config GAMES_NXDOOM_ROWSTAGE
	bool "Build each output row in a staging buffer"
	default n
	---help---
		Expand each row into a staging buffer and copy it to the frame
		buffer, rather than writing the frame buffer a pixel at a time.
		Every frame buffer access then becomes a burst-friendly copy, which
		is worth a lot when the frame buffer is external memory and the
		data cache is in write-through mode, and little otherwise.

		Costs a few kilobytes of .bss for the buffer.  A row that does not
		fit is written directly, as if this were disabled.

config GAMES_NXDOOM_STATIC_SCRNBUF
	bool "Place the render target in .bss"
	default n
	---help---
		DOOM renders into a 320x200 buffer that is normally taken from the
		heap.  On a board whose heap is mostly slow external memory the
		allocation lands there, which is close to the worst case:  the
		renderer draws in vertical columns, so consecutive writes are one
		screen width apart and none of them coalesce.

		Enable this to make the buffer a static object instead, so the
		linker places it in internal RAM along with the rest of .bss.  It
		costs 64000 bytes of RAM whether DOOM runs or not, so it is only
		worth it when internal RAM is plentiful and the heap is not.

comment "Optimizations"

config GAMES_NXDOOM_MAXVISPLANES
	int "Maximum number of visplanes"
	default 96
	---help---
		DOOM allocates a static number of 'visplanes' to use for gameplay. The
		original ChocolateDOOM source uses 128 of these. They take a significant
		amount of memory, so you may reduce the number. However, too few planes
		may cause 'visplane overflow' errors, which is more common in complex
		levels.

config GAMES_NXDOOM_MAXOPENINGS
	int "Maximum number of openings"
	default 32
	---help---
		DOOM allocates a static number of 'openings' to use for gameplay. These
		are defined as multiples of the SCREENWIDTH (320). The original
		ChocolateDOOM source uses 64 as the multiplier. They take a significant
		amount of memory, so you may reduce the number. However, too few
		openings will cause 'opening overflow' errors.

config GAMES_NXDOOM_MAXVISSPRITES
	int "Maximum number of visible sprites"
	default 96
	---help---
		DOOM allocates a static number of 'vissprites' to use for gameplay. The
		original ChocolateDOOM source uses 128. They take a significant amount
		of memory, so you may reduce the number. However, too few will cause
		overflow errors.

config GAMES_NXDOOM_MAXDRAWSEGS
	int "Maximum number of drawsegs"
	default 192
	---help---
		DOOM allocates a static number of 'drawsegs' to use for gameplay. The
		original ChocolateDOOM source uses 256. They take a significant amount of
		memory, so you may reduce the number. However, too few will cause
		rendering issues (overflow is checked to avoid crashes).

config GAMES_NXDOOM_STATDUMP_MAX_CAPTURES
	int "Maximum statdump capture buffer entries"
	default 32
	range 1 1024
	---help---
		Number of diagnostic playtime-statistics capture slots.

config GAMES_NXDOOM_RANGECHECK
	bool "Perform range checks"
	default y
	---help---
		The ChocolateDOOM source includes the ability to optionally exclude
		range checking on some array operations.

endif # GAMES_NXDOOM
```
